## configs/eo_v3_uboot_defconfig
```kconfig
CONFIG_CRYSTAL_24_000MHZ=y
CONFIG_CPU_CLK_498MHZ=y
CONFIG_CONSOLE_INDEX=0
CONFIG_DEBUG=y
CONFIG_DDR_SET_BY_DEVICE=y
CONFIG_DDR_AD220032D=y
CONFIG_SDCARD=y
# CONFIG_SDHC_8BIT_SUPPORT is not set
CONFIG_LED_ON_BOARD=y
CONFIG_LED_R_ON_PIOA=y
CONFIG_LED_R_PIN=13
CONFIG_LED_G_ON_PIOA=y
CONFIG_LED_G_PIN=11
CONFIG_LED_G_VALUE=0
```
